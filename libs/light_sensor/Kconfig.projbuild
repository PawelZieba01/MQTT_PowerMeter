## libs/light_sensor/Kconfig.projbuild
```kconfig
menu "Light Sensor Configuration"

    config SENSOR_PIN_POLARITY
            int "Light Sensor Pulse Polarity"
            default 0
            help
                Set the pulse polarity for the light sensor.
                If set to '1', the pulse is active high, set to '0' it is active low.

    config SENSOR_INPUT_PIN
        int "Light Sensor Input Pin"
        default 10
        help
            GPIO pin number for the light sensor input.
   
endmenu
```

## libs/mqtt_tcp/Kconfig.projbuild
```kconfig
menu "MQTT Configuration"
    config MQTT_PUBLISH_INTERVAL
        int "MQTT Publish Interval"
        default 300
        help
            Interval in seconds to publish data to the MQTT broker.

    config MQTT_BROKER_URL
        string "MQTT Broker URL"
        default "127.0.0.1"
        help
            URL of the MQTT broker to connect to.

    config MQTT_BROKER_PORT
        int "MQTT Broker Port"
        default 1883
        help
            Port of the MQTT broker to connect to.

    config MQTT_BROKER_USERNAME
        string "MQTT Broker Username"
        default "username"
        help
            Username for the MQTT broker.

    config MQTT_BROKER_PASSWORD
        string "MQTT Broker Password"
        default "password"
        help
            Password for the MQTT broker.
endmenu
```

## main/Kconfig.projbuild
```kconfig
menu "Project Configuration"
    config PROJECT_MQTT_PUB_TOPIC
        string "MQTT Topic"
        default "mqtt/power_meter/"
        help
            MQTT topic to publish temperature data to.
            At the end of this topic will be appended the device ip (last 3 digits).
            For example: mqtt/power_meter/121

endmenu
```
